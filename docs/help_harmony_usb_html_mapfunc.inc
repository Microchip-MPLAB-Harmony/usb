function HTML_ID_Mapping(id: Integer): Integer;
begin
  case id of
    IDH_USB_Demonstrations                                : result := IDH_HTML_USB_Demonstrations;
    IDH_APPS_USB_Introduction                             : result := IDH_HTML_APPS_USB_Introduction;
    IDH_APPS_USB_Pen_Drive_Tests                          : result := IDH_HTML_APPS_USB_Pen_Drive_Tests;
    IDH_APPS_USB_Device                                   : result := IDH_HTML_APPS_USB_Device;
    IDH_APPS_USB_cdc_com_port_dual                        : result := IDH_HTML_APPS_USB_cdc_com_port_dual;
    IDH_APPS_USB_cdc_com_port_dual_build                  : result := IDH_HTML_APPS_USB_cdc_com_port_dual_build;
    IDH_APPS_USB_cdc_com_port_dual_configure              : result := IDH_HTML_APPS_USB_cdc_com_port_dual_configure;
    IDH_APPS_USB_cdc_com_port_dual_run                    : result := IDH_HTML_APPS_USB_cdc_com_port_dual_run;
    IDH_APPS_USB_cdc_com_port_single                      : result := IDH_HTML_APPS_USB_cdc_com_port_single;
    IDH_APPS_USB_cdc_com_port_single_build                : result := IDH_HTML_APPS_USB_cdc_com_port_single_build;
    IDH_APPS_USB_cdc_com_port_single_configure            : result := IDH_HTML_APPS_USB_cdc_com_port_single_configure;
    IDH_APPS_USB_cdc_com_port_single_run                  : result := IDH_HTML_APPS_USB_cdc_com_port_single_run;
    IDH_APPS_USB_Device_cdc_msd                           : result := IDH_HTML_APPS_USB_Device_cdc_msd;
    IDH_APPS_USB_Device_cdc_msd_Build                     : result := IDH_HTML_APPS_USB_Device_cdc_msd_Build;
    IDH_APPS_USB_Device_cdc_msd_configure                 : result := IDH_HTML_APPS_USB_Device_cdc_msd_configure;
    IDH_APPS_USB_Device_cdc_msd_Run                       : result := IDH_HTML_APPS_USB_Device_cdc_msd_Run;
    IDH_APPS_USB_cdc_serial_emulator                      : result := IDH_HTML_APPS_USB_cdc_serial_emulator;
    IDH_APPS_USB_cdc_serial_emulator_build                : result := IDH_HTML_APPS_USB_cdc_serial_emulator_build;
    IDH_APPS_USB_cdc_serial_emulator_configure            : result := IDH_HTML_APPS_USB_cdc_serial_emulator_configure;
    IDH_APPS_USB_cdc_serial_emulator_run                  : result := IDH_HTML_APPS_USB_cdc_serial_emulator_run;
    IDH_APPS_USB_hid_basic                                : result := IDH_HTML_APPS_USB_hid_basic;
    IDH_APPS_USB_hid_basic_build                          : result := IDH_HTML_APPS_USB_hid_basic_build;
    IDH_APPS_USB_hid_basic_configure                      : result := IDH_HTML_APPS_USB_hid_basic_configure;
    IDH_APPS_USB_hid_basic_run                            : result := IDH_HTML_APPS_USB_hid_basic_run;
    IDH_APPS_USB_Device_HID_Joystick                      : result := IDH_HTML_APPS_USB_Device_HID_Joystick;
    IDH_APPS_USB_Device_hid_joystick_build                : result := IDH_HTML_APPS_USB_Device_hid_joystick_build;
    IDH_APPS_USB_Device_hid_joystick_configure            : result := IDH_HTML_APPS_USB_Device_hid_joystick_configure;
    IDH_APPS_USB_Device_hid_joystick_run                  : result := IDH_HTML_APPS_USB_Device_hid_joystick_run;
    IDH_APPS_USB_hid_keyboard                             : result := IDH_HTML_APPS_USB_hid_keyboard;
    IDH_APPS_USB_hid_keyboard_build                       : result := IDH_HTML_APPS_USB_hid_keyboard_build;
    IDH_APPS_USB_hid_keyboard_configure                   : result := IDH_HTML_APPS_USB_hid_keyboard_configure;
    IDH_APPS_USB_hid_keyboard_run                         : result := IDH_HTML_APPS_USB_hid_keyboard_run;
    IDH_APPS_USB_hid_mouse                                : result := IDH_HTML_APPS_USB_hid_mouse;
    IDH_APPS_USB_hid_mouse_build                          : result := IDH_HTML_APPS_USB_hid_mouse_build;
    IDH_APPS_USB_hid_mouse_configure                      : result := IDH_HTML_APPS_USB_hid_mouse_configure;
    IDH_APPS_USB_hid_mouse_run                            : result := IDH_HTML_APPS_USB_hid_mouse_run;
    IDH_APPS_USB_Device_hid_msd_basic                     : result := IDH_HTML_APPS_USB_Device_hid_msd_basic;
    IDH_APPS_USB_Device_hid_msd_basic_build               : result := IDH_HTML_APPS_USB_Device_hid_msd_basic_build;
    IDH_APPS_USB_Device_hid_msd_basic_configure           : result := IDH_HTML_APPS_USB_Device_hid_msd_basic_configure;
    IDH_APPS_USB_Device_hid_msd_basic_run                 : result := IDH_HTML_APPS_USB_Device_hid_msd_basic_run;
    IDH_APPS_USB_msd_basic                                : result := IDH_HTML_APPS_USB_msd_basic;
    IDH_APPS_USB_msd_basic_build                          : result := IDH_HTML_APPS_USB_msd_basic_build;
    IDH_APPS_USB_msd_basic_configure                      : result := IDH_HTML_APPS_USB_msd_basic_configure;
    IDH_APPS_USB_msd_basic_run                            : result := IDH_HTML_APPS_USB_msd_basic_run;
    IDH_APPS_USB_generic_device                           : result := IDH_HTML_APPS_USB_generic_device;
    IDH_APPS_USB_generic_device_build                     : result := IDH_HTML_APPS_USB_generic_device_build;
    IDH_APPS_USB_generic_device_configure                 : result := IDH_HTML_APPS_USB_generic_device_configure;
    IDH_APPS_USB_generic_device_run                       : result := IDH_HTML_APPS_USB_generic_device_run;
    IDH_APPS_USB_Host                                     : result := IDH_HTML_APPS_USB_Host;
    IDH_APPS_USB_cdc_basic                                : result := IDH_HTML_APPS_USB_cdc_basic;
    IDH_APPS_USB_cdc_basic_build                          : result := IDH_HTML_APPS_USB_cdc_basic_build;
    IDH_APPS_USB_cdc_basic_configure                      : result := IDH_HTML_APPS_USB_cdc_basic_configure;
    IDH_APPS_USB_cdc_basic_run                            : result := IDH_HTML_APPS_USB_cdc_basic_run;
    IDH_APPS_USB_cdc_msd                                  : result := IDH_HTML_APPS_USB_cdc_msd;
    IDH_APPS_USB_cdc_msd_build                            : result := IDH_HTML_APPS_USB_cdc_msd_build;
    IDH_APPS_USB_cdc_msd_configure                        : result := IDH_HTML_APPS_USB_cdc_msd_configure;
    IDH_APPS_USB_cdc_msd_run                              : result := IDH_HTML_APPS_USB_cdc_msd_run;
    IDH_APPS_USB_HOST_hid_basic_keyboard                  : result := IDH_HTML_APPS_USB_HOST_hid_basic_keyboard;
    IDH_APPS_USB_HOST_hid_basic_keyboard_build            : result := IDH_HTML_APPS_USB_HOST_hid_basic_keyboard_build;
    IDH_APPS_USB_HOST_hid_basic_keyboard_config           : result := IDH_HTML_APPS_USB_HOST_hid_basic_keyboard_config;
    IDH_APPS_USB_HOST_hid_basic_keyboard_run              : result := IDH_HTML_APPS_USB_HOST_hid_basic_keyboard_run;
    IDH_APPS_USB_msd_basic_host                           : result := IDH_HTML_APPS_USB_msd_basic_host;
    IDH_APPS_USB_msd_basic_host_build                     : result := IDH_HTML_APPS_USB_msd_basic_host_build;
    IDH_APPS_USB_msd_basic_host_configure                 : result := IDH_HTML_APPS_USB_msd_basic_host_configure;
    IDH_APPS_USB_msd_basic_host_run                       : result := IDH_HTML_APPS_USB_msd_basic_host_run;
    IDH_APPS_USB_Host_hid_basic_mouse_usart               : result := IDH_HTML_APPS_USB_Host_hid_basic_mouse_usart;
    IDH_APPS_USB_Host_hid_basic_mouse_usart_build         : result := IDH_HTML_APPS_USB_Host_hid_basic_mouse_usart_build;
    IDH_APPS_USB_Host_hid_basic_mouse_usart_configure     : result := IDH_HTML_APPS_USB_Host_hid_basic_mouse_usart_configure;
    IDH_APPS_USB_Host_hid_basic_mouse_usart_run           : result := IDH_HTML_APPS_USB_Host_hid_basic_mouse_usart_run;
    IDH_USB_Libraries_Help                                : result := IDH_HTML_USB_Libraries_Help;
    IDH_USB_Device_Libraries                              : result := IDH_HTML_USB_Device_Libraries;
    IDH_USB_Device_Library___Getting_Started              : result := IDH_HTML_USB_Device_Library___Getting_Started;
    IDH_USB_MID_Introduction                              : result := IDH_HTML_USB_MID_Introduction;
    IDH_USB_MID_USB_Device_Library_Architecture           : result := IDH_HTML_USB_MID_USB_Device_Library_Architecture;
    IDH_USB_MID_USB_Device_Library___Application_Interaction: result := IDH_HTML_USB_MID_USB_Device_Library___Application_Interaction;
    IDH_USB_MID_Creating_Your_Own_USB_Device              : result := IDH_HTML_USB_MID_Creating_Your_Own_USB_Device;
    IDH_USB_Device_Layer_Library                          : result := IDH_HTML_USB_Device_Layer_Library;
    IDH_USB_DEVLAYER_Introduction                         : result := IDH_HTML_USB_DEVLAYER_Introduction;
    IDH_USB_DEVLAYER_Using_the_Library                    : result := IDH_HTML_USB_DEVLAYER_Using_the_Library;
    IDH_USB_DEVLAYER_Abstraction_Model                    : result := IDH_HTML_USB_DEVLAYER_Abstraction_Model;
    IDH_USB_DEVLAYER_Library_Overview                     : result := IDH_HTML_USB_DEVLAYER_Library_Overview;
    IDH_USB_DEVLAYER_How_the_Library_Works                : result := IDH_HTML_USB_DEVLAYER_How_the_Library_Works;
    IDH_USB_DEVLAYER_Initializing_the_library             : result := IDH_HTML_USB_DEVLAYER_Initializing_the_library;
    IDH_USB_DEVLAYER_Master_Descriptor_Table              : result := IDH_HTML_USB_DEVLAYER_Master_Descriptor_Table;
    IDH_USB_DEVLAYER_Function_Driver_Registration_Table   : result := IDH_HTML_USB_DEVLAYER_Function_Driver_Registration_Table;
    IDH_USB_DEVLAYER_Initializing_the_Device_Layer        : result := IDH_HTML_USB_DEVLAYER_Initializing_the_Device_Layer;
    IDH_USB_DEVLAYER_Device_Layer_Task_Routines           : result := IDH_HTML_USB_DEVLAYER_Device_Layer_Task_Routines;
    IDH_USB_DEVLAYER_Application_Client_Interaction       : result := IDH_HTML_USB_DEVLAYER_Application_Client_Interaction;
    IDH_USB_DEVLAYER_Event_Handling                       : result := IDH_HTML_USB_DEVLAYER_Event_Handling;
    IDH_USB_DEVLAYER_Device_Layer_Control_Transfer        : result := IDH_HTML_USB_DEVLAYER_Device_Layer_Control_Transfer;
    IDH_USB_DEVLAYER_String_Descriptor_Table              : result := IDH_HTML_USB_DEVLAYER_String_Descriptor_Table;
    IDH_USB_DEVLAYER_BOS_Descriptor_Support               : result := IDH_HTML_USB_DEVLAYER_BOS_Descriptor_Support;
    IDH_USB_DEVLAYER_Library_Configuration                : result := IDH_HTML_USB_DEVLAYER_Library_Configuration;
    IDH_USB_DEVLAYER_Building_the_Library                 : result := IDH_HTML_USB_DEVLAYER_Building_the_Library;
    IDH_USB_DEVLAYER_Library_Interface                    : result := IDH_HTML_USB_DEVLAYER_Library_Interface;
    IDH_USB_DEVLAYER_Files                                : result := IDH_HTML_USB_DEVLAYER_Files;
    IDH_usb_device_h                                      : result := IDH_HTML_usb_device_h;
    IDH_usb_device_config_template_h                      : result := IDH_HTML_usb_device_config_template_h;
    IDH_USB_Audio_1_0_Device_Library                      : result := IDH_HTML_USB_Audio_1_0_Device_Library;
    IDH_USB_AUDDEV_V1_0_Introduction                      : result := IDH_HTML_USB_AUDDEV_V1_0_Introduction;
    IDH_USB_AUDDEV_V1_0_Using_the_Library                 : result := IDH_HTML_USB_AUDDEV_V1_0_Using_the_Library;
    IDH_USB_AUDDEV_V1_0_Abstraction_Model                 : result := IDH_HTML_USB_AUDDEV_V1_0_Abstraction_Model;
    IDH_USB_AUDDEV_V1_0_Library_Architecture              : result := IDH_HTML_USB_AUDDEV_V1_0_Library_Architecture;
    IDH_USB_AUDDEV_V1_0_How_the_Library_Works             : result := IDH_HTML_USB_AUDDEV_V1_0_How_the_Library_Works;
    IDH_USB_AUDDEV_V1_0__Initializing_the_Library         : result := IDH_HTML_USB_AUDDEV_V1_0__Initializing_the_Library;
    IDH_USB_AUDDEV_V1_0_Event_Handling                    : result := IDH_HTML_USB_AUDDEV_V1_0_Event_Handling;
    IDH_USB_AUDDEV_V1_0_Transferring_Data                 : result := IDH_HTML_USB_AUDDEV_V1_0_Transferring_Data;
    IDH_USB_AUDDEV_V1_0_Configuring_the_Library           : result := IDH_HTML_USB_AUDDEV_V1_0_Configuring_the_Library;
    IDH_USB_AUDDEV_V1_0_Building_the_Library              : result := IDH_HTML_USB_AUDDEV_V1_0_Building_the_Library;
    IDH_USB_AUDDEV_V1_0_Library_Interface                 : result := IDH_HTML_USB_AUDDEV_V1_0_Library_Interface;
    IDH_USB_AUDDEV_V1_0_Files                             : result := IDH_HTML_USB_AUDDEV_V1_0_Files;
    IDH_usb_device_audio_v1_0_h                           : result := IDH_HTML_usb_device_audio_v1_0_h;
    IDH_usb_device_audio_v1_0_config_template_h           : result := IDH_HTML_usb_device_audio_v1_0_config_template_h;
    IDH_USB_Audio_2_0_Device_Library                      : result := IDH_HTML_USB_Audio_2_0_Device_Library;
    IDH_USB_AUDDEV_V2_0_Introduction                      : result := IDH_HTML_USB_AUDDEV_V2_0_Introduction;
    IDH_USB_AUDDEV_V2_0_Using_the_Library                 : result := IDH_HTML_USB_AUDDEV_V2_0_Using_the_Library;
    IDH_USB_AUDDEV_V2_0_Abstraction_Model                 : result := IDH_HTML_USB_AUDDEV_V2_0_Abstraction_Model;
    IDH_USB_AUDDEV_V2_0_Library_Architecture              : result := IDH_HTML_USB_AUDDEV_V2_0_Library_Architecture;
    IDH_USB_AUDDEV_V2_0_How_the_Library_Works             : result := IDH_HTML_USB_AUDDEV_V2_0_How_the_Library_Works;
    IDH_USB_AUDDEV_V2_0_Initializing_the_Library          : result := IDH_HTML_USB_AUDDEV_V2_0_Initializing_the_Library;
    IDH_USB_AUDDEV_V2_0_Event_Handling                    : result := IDH_HTML_USB_AUDDEV_V2_0_Event_Handling;
    IDH_USB_AUDDEV_V2_0_Transferring_Data                 : result := IDH_HTML_USB_AUDDEV_V2_0_Transferring_Data;
    IDH_USB_AUDDEV_V2_0_Configuring_the_Library           : result := IDH_HTML_USB_AUDDEV_V2_0_Configuring_the_Library;
    IDH_USB_AUDDEV_V2_0_Building_the_Library              : result := IDH_HTML_USB_AUDDEV_V2_0_Building_the_Library;
    IDH_USB_AUDDEV_V2_0_Library_Interface                 : result := IDH_HTML_USB_AUDDEV_V2_0_Library_Interface;
    IDH_USB_AUDDEV_V2_0_Files                             : result := IDH_HTML_USB_AUDDEV_V2_0_Files;
    IDH_usb_device_audio_v2_0_h                           : result := IDH_HTML_usb_device_audio_v2_0_h;
    IDH_usb_device_audio_v2_0_config_template_h           : result := IDH_HTML_usb_device_audio_v2_0_config_template_h;
    IDH_USB_Device_CDC_Library                            : result := IDH_HTML_USB_Device_CDC_Library;
    IDH_USB_DEVCDC_Introduction                           : result := IDH_HTML_USB_DEVCDC_Introduction;
    IDH_USB_DEVCDC_Using_the_Library                      : result := IDH_HTML_USB_DEVCDC_Using_the_Library;
    IDH_USB_DEVCDC_Abstraction_Model                      : result := IDH_HTML_USB_DEVCDC_Abstraction_Model;
    IDH_USB_DEVCDC_Abstract_Control_Model__ACM_           : result := IDH_HTML_USB_DEVCDC_Abstract_Control_Model__ACM_;
    IDH_USB_DEVCDC_Library_Architecture                   : result := IDH_HTML_USB_DEVCDC_Library_Architecture;
    IDH_USB_DEVCDC_How_the_Library_Works                  : result := IDH_HTML_USB_DEVCDC_How_the_Library_Works;
    IDH_USB_DEVCDC_Library_Initialization                 : result := IDH_HTML_USB_DEVCDC_Library_Initialization;
    IDH_USB_DEVCDC_Event_Handling                         : result := IDH_HTML_USB_DEVCDC_Event_Handling;
    IDH_USB_DEVCDC_Sending_Data                           : result := IDH_HTML_USB_DEVCDC_Sending_Data;
    IDH_USB_DEVCDC_Receiving_Data                         : result := IDH_HTML_USB_DEVCDC_Receiving_Data;
    IDH_USB_DEVCDC_Configuring_the_Library                : result := IDH_HTML_USB_DEVCDC_Configuring_the_Library;
    IDH_USB_DEVCDC_Building_the_Library                   : result := IDH_HTML_USB_DEVCDC_Building_the_Library;
    IDH_USB_DEVCDC_Library_Interface                      : result := IDH_HTML_USB_DEVCDC_Library_Interface;
    IDH_USB_DEVCDC_Files                                  : result := IDH_HTML_USB_DEVCDC_Files;
    IDH_usb_device_cdc_h                                  : result := IDH_HTML_usb_device_cdc_h;
    IDH_usb_cdc_h                                         : result := IDH_HTML_usb_cdc_h;
    IDH_usb_device_cdc_config_template_h                  : result := IDH_HTML_usb_device_cdc_config_template_h;
    IDH_USB_HID_Device_Library                            : result := IDH_HTML_USB_HID_Device_Library;
    IDH_USB_HIDDEV_Introduction                           : result := IDH_HTML_USB_HIDDEV_Introduction;
    IDH_USB_HIDDEV_Using_the_Library                      : result := IDH_HTML_USB_HIDDEV_Using_the_Library;
    IDH_USB_HIDDEV_Architecture_Overview                  : result := IDH_HTML_USB_HIDDEV_Architecture_Overview;
    IDH_USB_HIDDEV_Library_Architecture                   : result := IDH_HTML_USB_HIDDEV_Library_Architecture;
    IDH_USB_HIDDEV_How_the_Library_Works                  : result := IDH_HTML_USB_HIDDEV_How_the_Library_Works;
    IDH_USB_HIDDEV_Library_Initialization                 : result := IDH_HTML_USB_HIDDEV_Library_Initialization;
    IDH_USB_HIDDEV_Event_Handling                         : result := IDH_HTML_USB_HIDDEV_Event_Handling;
    IDH_USB_HIDDEV_Sending_a_Report                       : result := IDH_HTML_USB_HIDDEV_Sending_a_Report;
    IDH_USB_HIDDEV_Receiving_a_Report                     : result := IDH_HTML_USB_HIDDEV_Receiving_a_Report;
    IDH_USB_HIDDEV_Configuring_the_Library                : result := IDH_HTML_USB_HIDDEV_Configuring_the_Library;
    IDH_USB_HIDDEV_Building_the_Library                   : result := IDH_HTML_USB_HIDDEV_Building_the_Library;
    IDH_USB_HIDDEV_Library_Interface                      : result := IDH_HTML_USB_HIDDEV_Library_Interface;
    IDH_USB_HIDDEV_Files                                  : result := IDH_HTML_USB_HIDDEV_Files;
    IDH_usb_device_hid_h                                  : result := IDH_HTML_usb_device_hid_h;
    IDH_usb_device_hid_config_template_h                  : result := IDH_HTML_usb_device_hid_config_template_h;
    IDH_USB_Vendor_Device_Library                         : result := IDH_HTML_USB_Vendor_Device_Library;
    IDH_USB_VENDORDEV_Introduction                        : result := IDH_HTML_USB_VENDORDEV_Introduction;
    IDH_USB_VENDORDEV_Using_the_Library                   : result := IDH_HTML_USB_VENDORDEV_Using_the_Library;
    IDH_USB_VENDORDEV_Library_Overview                    : result := IDH_HTML_USB_VENDORDEV_Library_Overview;
    IDH_USB_VENDORDEV_Abstraction_Model                   : result := IDH_HTML_USB_VENDORDEV_Abstraction_Model;
    IDH_USB_VENDORDEV_How_the_Library_Works               : result := IDH_HTML_USB_VENDORDEV_How_the_Library_Works;
    IDH_USB_VENDORDEV_Library_Initialization              : result := IDH_HTML_USB_VENDORDEV_Library_Initialization;
    IDH_USB_VENDORDEV_Event_Handling                      : result := IDH_HTML_USB_VENDORDEV_Event_Handling;
    IDH_USB_VENDORDEV_Control_Transfer_Events             : result := IDH_HTML_USB_VENDORDEV_Control_Transfer_Events;
    IDH_USB_VENDORDEV_Endpoint_Data_Transfer_Events       : result := IDH_HTML_USB_VENDORDEV_Endpoint_Data_Transfer_Events;
    IDH_USB_VENDORDEV_Endpoint_Management                 : result := IDH_HTML_USB_VENDORDEV_Endpoint_Management;
    IDH_USB_VENDORDEV_Endpoint_Data_Transfer              : result := IDH_HTML_USB_VENDORDEV_Endpoint_Data_Transfer;
    IDH_USB_VENDORDEV_Configuring_the_Library             : result := IDH_HTML_USB_VENDORDEV_Configuring_the_Library;
    IDH_USB_VENDORDEV_Building_the_Library                : result := IDH_HTML_USB_VENDORDEV_Building_the_Library;
    IDH_USB_VENDORDEV_Library_Interface                   : result := IDH_HTML_USB_VENDORDEV_Library_Interface;
    IDH_USB_MSD_Device_Library                            : result := IDH_HTML_USB_MSD_Device_Library;
    IDH_USB_MSDDEV_Introduction                           : result := IDH_HTML_USB_MSDDEV_Introduction;
    IDH_USB_MSDDEV_Using_the_Library                      : result := IDH_HTML_USB_MSDDEV_Using_the_Library;
    IDH_USB_MSDDEV_Abstraction_Model                      : result := IDH_HTML_USB_MSDDEV_Abstraction_Model;
    IDH_USB_MSDDEV_Library_Overview                       : result := IDH_HTML_USB_MSDDEV_Library_Overview;
    IDH_USB_MSDDEV_How_the_Library_Works                  : result := IDH_HTML_USB_MSDDEV_How_the_Library_Works;
    IDH_USB_MSDDEV_Library_Initialization                 : result := IDH_HTML_USB_MSDDEV_Library_Initialization;
    IDH_USB_MSDDEV_Data_Transfer                          : result := IDH_HTML_USB_MSDDEV_Data_Transfer;
    IDH_USB_MSD_Configuring_the_Library                   : result := IDH_HTML_USB_MSD_Configuring_the_Library;
    IDH_USB_MSDDEV_Building_the_Library                   : result := IDH_HTML_USB_MSDDEV_Building_the_Library;
    IDH_USB_MSDDEV_Library_Interface                      : result := IDH_HTML_USB_MSDDEV_Library_Interface;
    IDH_USB_MSDDEV_Files                                  : result := IDH_HTML_USB_MSDDEV_Files;
    IDH_usb_device_msd_h                                  : result := IDH_HTML_usb_device_msd_h;
    IDH_usb_device_msd_config_template_h                  : result := IDH_HTML_usb_device_msd_config_template_h;
    IDH_USB_Host_Libraries                                : result := IDH_HTML_USB_Host_Libraries;
    IDH_USB_Host_Library___Getting_Started                : result := IDH_HTML_USB_Host_Library___Getting_Started;
    IDH_USB_HOST_GS_Introduction                          : result := IDH_HTML_USB_HOST_GS_Introduction;
    IDH_USB_HOST_GS_USB_Host_Library_Architecture         : result := IDH_HTML_USB_HOST_GS_USB_Host_Library_Architecture;
    IDH_USB_HOST_GS_USB_Host_Library___Application_Interaction: result := IDH_HTML_USB_HOST_GS_USB_Host_Library___Application_Interaction;
    IDH_USB_Host_Layer_Library                            : result := IDH_HTML_USB_Host_Layer_Library;
    IDH_USB_HOST_Introduction                             : result := IDH_HTML_USB_HOST_Introduction;
    IDH_USB_HOST_Using_the_Library                        : result := IDH_HTML_USB_HOST_Using_the_Library;
    IDH_USB_HOST_Abstraction_Model                        : result := IDH_HTML_USB_HOST_Abstraction_Model;
    IDH_USB_HOST_Library_Overview                         : result := IDH_HTML_USB_HOST_Library_Overview;
    IDH_USB_HOST_How_the_Library_Works                    : result := IDH_HTML_USB_HOST_How_the_Library_Works;
    IDH_USB_HOST_Host_Layer_Initialization                : result := IDH_HTML_USB_HOST_Host_Layer_Initialization;
    IDH_USB_HOST_Host_Layer___Application_Interaction     : result := IDH_HTML_USB_HOST_Host_Layer___Application_Interaction;
    IDH_USB_HOST_Event_Handling                           : result := IDH_HTML_USB_HOST_Event_Handling;
    IDH_USB_HOST_Configuring_the_Library                  : result := IDH_HTML_USB_HOST_Configuring_the_Library;
    IDH_USB_HOST_Building_the_Library                     : result := IDH_HTML_USB_HOST_Building_the_Library;
    IDH_USB_HOST_Library_Interface                        : result := IDH_HTML_USB_HOST_Library_Interface;
    IDH_USB_HOST_Files                                    : result := IDH_HTML_USB_HOST_Files;
    IDH_usb_host_h                                        : result := IDH_HTML_usb_host_h;
    IDH_usb_host_config_template_h                        : result := IDH_HTML_usb_host_config_template_h;
    IDH_USB_Audio_v1_0_Host_Client_Driver_Library         : result := IDH_HTML_USB_Audio_v1_0_Host_Client_Driver_Library;
    IDH_USB_AUDIO1_0_HOST_Introduction                    : result := IDH_HTML_USB_AUDIO1_0_HOST_Introduction;
    IDH_USB_AUDIO1_0_HOST_Using_the_Library               : result := IDH_HTML_USB_AUDIO1_0_HOST_Using_the_Library;
    IDH_USB_AUDIO1_0_HOST_Abstraction_Model               : result := IDH_HTML_USB_AUDIO1_0_HOST_Abstraction_Model;
    IDH_USB_AUDIO1_0_HOST_Library_Architecture            : result := IDH_HTML_USB_AUDIO1_0_HOST_Library_Architecture;
    IDH_USB_AUDIO1_0_HOST_How_the_Library_Works           : result := IDH_HTML_USB_AUDIO1_0_HOST_How_the_Library_Works;
    IDH_USB_AUDIO1_0_HOST_TPL_Table_Configuration_for_Audio_v1_0_Devices: result := IDH_HTML_USB_AUDIO1_0_HOST_TPL_Table_Configuration_for_Audio_v1_0_Devices;
    IDH_USB_AUDIO1_0_HOST_Detecting_Device_Attach         : result := IDH_HTML_USB_AUDIO1_0_HOST_Detecting_Device_Attach;
    IDH_USB_AUDIO1_0_HOST_Obtaining_Audio_v1_0_Device_Audio_Stream_Details: result := IDH_HTML_USB_AUDIO1_0_HOST_Obtaining_Audio_v1_0_Device_Audio_Stream_Details;
    IDH_USB_AUDIO1_0_HOST_Obtaining_an_Audio_Stream       : result := IDH_HTML_USB_AUDIO1_0_HOST_Obtaining_an_Audio_Stream;
    IDH_USB_AUDIO1_0_HOST_Audio_Stream_Event_Handling     : result := IDH_HTML_USB_AUDIO1_0_HOST_Audio_Stream_Event_Handling;
    IDH_USB_AUDIO1_0_HOST_Enabling_Audio_Stream           : result := IDH_HTML_USB_AUDIO1_0_HOST_Enabling_Audio_Stream;
    IDH_USB_AUDIO1_0_HOST_Setting_the_Desired_Audio_Stream_Sampling_Rate: result := IDH_HTML_USB_AUDIO1_0_HOST_Setting_the_Desired_Audio_Stream_Sampling_Rate;
    IDH_USB_AUDIO1_0_HOST_Audio_Data_Streaming            : result := IDH_HTML_USB_AUDIO1_0_HOST_Audio_Data_Streaming;
    IDH_USB_AUDIO1_0_HOST_Sending_Class_Specific_Control_Transfers: result := IDH_HTML_USB_AUDIO1_0_HOST_Sending_Class_Specific_Control_Transfers;
    IDH_USB_AUDIO1_0_HOST_Configuring_the_Library         : result := IDH_HTML_USB_AUDIO1_0_HOST_Configuring_the_Library;
    IDH_USB_AUDIO1_0_HOST_Building_the_Library            : result := IDH_HTML_USB_AUDIO1_0_HOST_Building_the_Library;
    IDH_USB_AUDIO1_0_HOST_Library_Interface               : result := IDH_HTML_USB_AUDIO1_0_HOST_Library_Interface;
    IDH_USB_AUDIO1_0_HOST_Files                           : result := IDH_HTML_USB_AUDIO1_0_HOST_Files;
    IDH_usb_host_audio_v1_0_h                             : result := IDH_HTML_usb_host_audio_v1_0_h;
    IDH_usb_host_cdc_h                                    : result := IDH_HTML_usb_host_cdc_h;
    IDH_usb_host_hub_config_template_h                    : result := IDH_HTML_usb_host_hub_config_template_h;
    IDH_usb_host_audio_v1_0_config_template_h             : result := IDH_HTML_usb_host_audio_v1_0_config_template_h;
    IDH_USB_CDC_Host_Library                              : result := IDH_HTML_USB_CDC_Host_Library;
    IDH_USB_CDC_HOST_Introduction                         : result := IDH_HTML_USB_CDC_HOST_Introduction;
    IDH_USB_CDC_HOST_Using_the_Library                    : result := IDH_HTML_USB_CDC_HOST_Using_the_Library;
    IDH_USB_CDC_HOST_Abstraction_Model                    : result := IDH_HTML_USB_CDC_HOST_Abstraction_Model;
    IDH_USB_CDC_HOST_Library_Overview                     : result := IDH_HTML_USB_CDC_HOST_Library_Overview;
    IDH_USB_CDC_HOST_How_the_Library_Works                : result := IDH_HTML_USB_CDC_HOST_How_the_Library_Works;
    IDH_USB_CDC_HOST_TPL_Table_Configuration_for_CDC_Devices: result := IDH_HTML_USB_CDC_HOST_TPL_Table_Configuration_for_CDC_Devices;
    IDH_USB_CDC_HOST_Detecting_Device_Attach              : result := IDH_HTML_USB_CDC_HOST_Detecting_Device_Attach;
    IDH_USB_CDC_HOST_Opening_the_CDC_Host_Client_Driver   : result := IDH_HTML_USB_CDC_HOST_Opening_the_CDC_Host_Client_Driver;
    IDH_USB_CDC_HOST_Sending_Class_specific_Control_Transfers: result := IDH_HTML_USB_CDC_HOST_Sending_Class_specific_Control_Transfers;
    IDH_USB_CDC_HOST_Reading_and_Writing_Data             : result := IDH_HTML_USB_CDC_HOST_Reading_and_Writing_Data;
    IDH_USB_CDC_HOST_Event_Handling                       : result := IDH_HTML_USB_CDC_HOST_Event_Handling;
    IDH_USB_CDC_HOST_Configuring_the_Library              : result := IDH_HTML_USB_CDC_HOST_Configuring_the_Library;
    IDH_USB_CDC_HOST_Building_the_Library                 : result := IDH_HTML_USB_CDC_HOST_Building_the_Library;
    IDH_USB_CDC_HOST_Library_Interface                    : result := IDH_HTML_USB_CDC_HOST_Library_Interface;
    IDH_USB_CDC_HOST_Files                                : result := IDH_HTML_USB_CDC_HOST_Files;
    IDH_usb_host_cdc_config_template_h                    : result := IDH_HTML_usb_host_cdc_config_template_h;
    IDH_USB_HID_Host_Mouse_Driver_Library                 : result := IDH_HTML_USB_HID_Host_Mouse_Driver_Library;
    IDH_USB_HID_HOST_MOUSE_Introduction                   : result := IDH_HTML_USB_HID_HOST_MOUSE_Introduction;
    IDH_USB_HID_HOST_MOUSE_Using_the_Library              : result := IDH_HTML_USB_HID_HOST_MOUSE_Using_the_Library;
    IDH_USB_HID_HOST_MOUSE_Abstraction_Model              : result := IDH_HTML_USB_HID_HOST_MOUSE_Abstraction_Model;
    IDH_USB_HID_HOST_MOUSE_Library_Architecture           : result := IDH_HTML_USB_HID_HOST_MOUSE_Library_Architecture;
    IDH_USB_HID_HOST_MOUSE_How_the_Library_Works          : result := IDH_HTML_USB_HID_HOST_MOUSE_How_the_Library_Works;
    IDH_USB_HID_HOST_MOUSE_HID_Device_TPL_Table_Configuration: result := IDH_HTML_USB_HID_HOST_MOUSE_HID_Device_TPL_Table_Configuration;
    IDH_USB_HID_HOST_MOUSE_Detecting_Device_Attach        : result := IDH_HTML_USB_HID_HOST_MOUSE_Detecting_Device_Attach;
    IDH_USB_HID_HOST_MOUSE_Mouse_Data_Event_Handling      : result := IDH_HTML_USB_HID_HOST_MOUSE_Mouse_Data_Event_Handling;
    IDH_USB_HID_HOST_MOUSE_Configuring_the_Library        : result := IDH_HTML_USB_HID_HOST_MOUSE_Configuring_the_Library;
    IDH_USB_HID_HOST_MOUSE_Building_the_Library           : result := IDH_HTML_USB_HID_HOST_MOUSE_Building_the_Library;
    IDH_USB_HID_HOST_MOUSE_Library_Interface              : result := IDH_HTML_USB_HID_HOST_MOUSE_Library_Interface;
    IDH_USB_HID_HOST_MOUSE_Files                          : result := IDH_HTML_USB_HID_HOST_MOUSE_Files;
    IDH_usb_host_hid_mouse_h                              : result := IDH_HTML_usb_host_hid_mouse_h;
    IDH_usb_host_hid_config_template_h                    : result := IDH_HTML_usb_host_hid_config_template_h;
    IDH_USB_Hub_Host_Client_Driver_Library                : result := IDH_HTML_USB_Hub_Host_Client_Driver_Library;
    IDH_USB_HUB_HOST_Introduction                         : result := IDH_HTML_USB_HUB_HOST_Introduction;
    IDH_USB_HUB_HOST_Using_the_Library                    : result := IDH_HTML_USB_HUB_HOST_Using_the_Library;
    IDH_USB_HUB_HOST_Abstraction_Model                    : result := IDH_HTML_USB_HUB_HOST_Abstraction_Model;
    IDH_USB_HUB_HOST_Library_Architecture                 : result := IDH_HTML_USB_HUB_HOST_Library_Architecture;
    IDH_USB_HUB_HOST_How_the_Library_Works                : result := IDH_HTML_USB_HUB_HOST_How_the_Library_Works;
    IDH_USB_HUB_HOST_Hub_TPL_Table_Configuration          : result := IDH_HTML_USB_HUB_HOST_Hub_TPL_Table_Configuration;
    IDH_USB_HUB_HOST_USB_Host_Hub_Driver_Test_Results     : result := IDH_HTML_USB_HUB_HOST_USB_Host_Hub_Driver_Test_Results;
    IDH_USB_HUB_HOST_Configuring_the_Library              : result := IDH_HTML_USB_HUB_HOST_Configuring_the_Library;
    IDH_USB_HUB_HOST_Building_the_Library                 : result := IDH_HTML_USB_HUB_HOST_Building_the_Library;
    IDH_USB_HUB_HOST_Library_Interface                    : result := IDH_HTML_USB_HUB_HOST_Library_Interface;
    IDH_USB_HUB_HOST_Files                                : result := IDH_HTML_USB_HUB_HOST_Files;
    IDH_usb_host_hub_h                                    : result := IDH_HTML_usb_host_hub_h;
    IDH_USB_MSD_Host_Library                              : result := IDH_HTML_USB_MSD_Host_Library;
    IDH_USB_MSD_HOST_Introduction                         : result := IDH_HTML_USB_MSD_HOST_Introduction;
    IDH_USB_MSD_HOST_Using_the_Library                    : result := IDH_HTML_USB_MSD_HOST_Using_the_Library;
    IDH_USB_MSD_HOST_Abstraction_Model                    : result := IDH_HTML_USB_MSD_HOST_Abstraction_Model;
    IDH_USB_MSD_HOST_Library_Architecture                 : result := IDH_HTML_USB_MSD_HOST_Library_Architecture;
    IDH_USB_MSD_HOST_How_the_Library_Works                : result := IDH_HTML_USB_MSD_HOST_How_the_Library_Works;
    IDH_USB_MSD_HOST_MSD_TPL_Table_Configuration          : result := IDH_HTML_USB_MSD_HOST_MSD_TPL_Table_Configuration;
    IDH_USB_MSD_HOST_Data_Transfer                        : result := IDH_HTML_USB_MSD_HOST_Data_Transfer;
    IDH_USB_MSD_HOST_Configuring_the_Library              : result := IDH_HTML_USB_MSD_HOST_Configuring_the_Library;
    IDH_USB_MSD_HOST_Building_the_Library                 : result := IDH_HTML_USB_MSD_HOST_Building_the_Library;
    IDH_USB_MSD_HOST_Library_Interface                    : result := IDH_HTML_USB_MSD_HOST_Library_Interface;
    IDH_USB_MSD_HOST_Files                                : result := IDH_HTML_USB_MSD_HOST_Files;
    IDH_usb_host_msd_h                                    : result := IDH_HTML_usb_host_msd_h;
    IDH_usb_host_msd_config_template_h                    : result := IDH_HTML_usb_host_msd_config_template_h;
    IDH_usb_drv_common_Library                            : result := IDH_HTML_usb_drv_common_Library;
    IDH_DRV_USB_COMMON_Common_Interface                   : result := IDH_HTML_DRV_USB_COMMON_Common_Interface;
    IDH_DRV_USB_COMMON_Driver_Host_Mode_Client_Functions  : result := IDH_HTML_DRV_USB_COMMON_Driver_Host_Mode_Client_Functions;
    IDH_DRV_USB_COMMON_Driver_Host_Root_Hub_Interface     : result := IDH_HTML_DRV_USB_COMMON_Driver_Host_Root_Hub_Interface;
    IDH_DRV_USB_COMMON_Driver_Host_USB_Root_Hub_Port_Interface: result := IDH_HTML_DRV_USB_COMMON_Driver_Host_USB_Root_Hub_Port_Interface;
    IDH_DRV_USB_COMMON_Driver_Device_Mode_Client_Functions: result := IDH_HTML_DRV_USB_COMMON_Driver_Device_Mode_Client_Functions;
    IDH_DRV_USB_COMMON_Driver_General_Client_Functions    : result := IDH_HTML_DRV_USB_COMMON_Driver_General_Client_Functions;
    IDH_DRV_USB_COMMON_Opening_the_Driver                 : result := IDH_HTML_DRV_USB_COMMON_Opening_the_Driver;
    IDH_DRV_USB_COMMON_USB_Driver_Host_Mode_Operation     : result := IDH_HTML_DRV_USB_COMMON_USB_Driver_Host_Mode_Operation;
    IDH_DRV_USB_COMMON_USB_Driver_Device_Mode_Operation   : result := IDH_HTML_DRV_USB_COMMON_USB_Driver_Device_Mode_Operation;
    IDH_DRV_USB_COMMON_General_Device_Mode_Operations     : result := IDH_HTML_DRV_USB_COMMON_General_Device_Mode_Operations;
    IDH_DRV_USB_COMMON_Device_Endpoint_Operations         : result := IDH_HTML_DRV_USB_COMMON_Device_Endpoint_Operations;
    IDH_DRV_USB_COMMON_Transferring_Data_to_the_Host      : result := IDH_HTML_DRV_USB_COMMON_Transferring_Data_to_the_Host;
    IDH_USB_DEV_DRV_WIN8_Driver_Signing_and_Windows_8     : result := IDH_HTML_USB_DEV_DRV_WIN8_Driver_Signing_and_Windows_8;
    IDH_USB_DRV_DEV_WIN_8_What_are__Signed__Drivers       : result := IDH_HTML_USB_DRV_DEV_WIN_8_What_are__Signed__Drivers;
    IDH_USB_DEV_DRV_WIN8_Minimum_Driver_Signature_Requirements: result := IDH_HTML_USB_DEV_DRV_WIN8_Minimum_Driver_Signature_Requirements;
    IDH_USB_DEV_DRV_WIN8_Using_Older_Drivers_With_Windows_8: result := IDH_HTML_USB_DEV_DRV_WIN8_Using_Older_Drivers_With_Windows_8;
    IDH_USB_DEV_DRV_WIN8_USB_Application_Project_Driver_Signatures: result := IDH_HTML_USB_DEV_DRV_WIN8_USB_Application_Project_Driver_Signatures;
    IDH_USB_DEV_DRV_WIN8_Obtaining_a_Microsoft_Authenticode_Code_Signing_Certificate: result := IDH_HTML_USB_DEV_DRV_WIN8_Obtaining_a_Microsoft_Authenticode_Code_Signing_Certificate;
    IDH_USB_DEV_DRV_WIN8_Code_Signing_Certificates__Other_Uses_: result := IDH_HTML_USB_DEV_DRV_WIN8_Code_Signing_Certificates__Other_Uses_;
    IDH_USB_DEV_DRV_WIN8_Using_a_Code_Signing_Certificate_to_Sign_Driver_Packages: result := IDH_HTML_USB_DEV_DRV_WIN8_Using_a_Code_Signing_Certificate_to_Sign_Driver_Packages;
    IDH_HARMONY_Support                                   : result := IDH_HTML_HARMONY_Support;
    IDH_HARMONY_About_This_Help_File                      : result := IDH_HTML_HARMONY_About_This_Help_File;
    IDH_HARMONY_Trademarks                                : result := IDH_HTML_HARMONY_Trademarks;
    IDH_HARMONY_Conventions_Used                          : result := IDH_HTML_HARMONY_Conventions_Used;
    IDH_HARMONY_Recommended_Reading                       : result := IDH_HTML_HARMONY_Recommended_Reading;
    IDH_HARMONY_Documentation_Feedback                    : result := IDH_HTML_HARMONY_Documentation_Feedback;
    IDH_HARMONY_Help_Features                             : result := IDH_HTML_HARMONY_Help_Features;
    IDH_HARMONY_Compiled_Help_Features                    : result := IDH_HTML_HARMONY_Compiled_Help_Features;
    IDH_HARMONY_HTML_Help_Features                        : result := IDH_HTML_HARMONY_HTML_Help_Features;
    IDH_HARMONY_PDF_Help_Features                         : result := IDH_HTML_HARMONY_PDF_Help_Features;
    IDH_HARMONY_The_Microchip_Web_Site                    : result := IDH_HTML_HARMONY_The_Microchip_Web_Site;
    IDH_HARMONY_Microchip_Forums                          : result := IDH_HTML_HARMONY_Microchip_Forums;
    IDH_HARMONY_Customer_Support                          : result := IDH_HTML_HARMONY_Customer_Support;
    IDH_HARMONY_Contact_Microchip_Technology              : result := IDH_HTML_HARMONY_Contact_Microchip_Technology;
    IDH_HARMONY_Glossary                                  : result := IDH_HTML_HARMONY_Glossary;
    IDH_Topic1                                            : result := IDH_HTML_Topic1;
    IDH___FILES                                           : result := IDH_HTML___FILES;
    IDH_drv_usbfs_config_template_h                       : result := IDH_HTML_drv_usbfs_config_template_h;
    else result := -1;
  end;
end;
