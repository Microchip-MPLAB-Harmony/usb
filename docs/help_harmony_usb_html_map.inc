    IDH_HTML_USB_Demonstrations                        = $00000000; // USB Demonstrations
    IDH_HTML_APPS_USB_Introduction                     = $00000001; // APPS USB Introduction
    IDH_HTML_APPS_USB_Pen_Drive_Tests                  = $00000002; // APPS USB Pen Drive Tests
    IDH_HTML_APPS_USB_Device                           = $00000003; // APPS USB Device
    IDH_HTML_APPS_USB_cdc_com_port_dual                = $00000004; // APPS USB cdc_com_port_dual
    IDH_HTML_APPS_USB_cdc_com_port_dual_build          = $00000005; // APPS USB cdc_com_port_dual_build
    IDH_HTML_APPS_USB_cdc_com_port_dual_configure      = $00000006; // APPS USB cdc_com_port_dual_configure
    IDH_HTML_APPS_USB_cdc_com_port_dual_run            = $00000007; // APPS USB cdc_com_port_dual_run
    IDH_HTML_APPS_USB_cdc_com_port_single              = $00000008; // APPS USB cdc_com_port_single
    IDH_HTML_APPS_USB_cdc_com_port_single_build        = $00000009; // APPS USB cdc_com_port_single_build
    IDH_HTML_APPS_USB_cdc_com_port_single_configure    = $0000000A; // APPS USB cdc_com_port_single_configure
    IDH_HTML_APPS_USB_cdc_com_port_single_run          = $0000000B; // APPS USB cdc_com_port_single_run
    IDH_HTML_APPS_USB_Device_cdc_msd                   = $0000000C; // APPS USB Device cdc_msd
    IDH_HTML_APPS_USB_Device_cdc_msd_Build             = $0000000D; // APPS USB Device cdc_msd Build
    IDH_HTML_APPS_USB_Device_cdc_msd_configure         = $0000000E; // APPS USB Device cdc_msd configure
    IDH_HTML_APPS_USB_Device_cdc_msd_Run               = $0000000F; // APPS USB Device cdc_msd Run
    IDH_HTML_APPS_USB_cdc_serial_emulator              = $00000010; // APPS USB cdc_serial_emulator
    IDH_HTML_APPS_USB_cdc_serial_emulator_build        = $00000011; // APPS USB cdc_serial_emulator_build
    IDH_HTML_APPS_USB_cdc_serial_emulator_configure    = $00000012; // APPS USB cdc_serial_emulator_configure
    IDH_HTML_APPS_USB_cdc_serial_emulator_run          = $00000013; // APPS USB cdc_serial_emulator_run
    IDH_HTML_APPS_USB_hid_basic                        = $00000014; // APPS USB hid_basic
    IDH_HTML_APPS_USB_hid_basic_build                  = $00000015; // APPS USB hid_basic_build
    IDH_HTML_APPS_USB_hid_basic_configure              = $00000016; // APPS USB hid_basic_configure
    IDH_HTML_APPS_USB_hid_basic_run                    = $00000017; // APPS USB hid_basic_run
    IDH_HTML_APPS_USB_Device_HID_Joystick              = $00000018; // APPS USB Device HID Joystick
    IDH_HTML_APPS_USB_Device_hid_joystick_build        = $00000019; // APPS USB Device hid_joystick_build
    IDH_HTML_APPS_USB_Device_hid_joystick_configure    = $0000001A; // APPS USB Device hid_joystick_configure
    IDH_HTML_APPS_USB_Device_hid_joystick_run          = $0000001B; // APPS USB Device hid_joystick_run
    IDH_HTML_APPS_USB_hid_keyboard                     = $0000001C; // APPS USB hid_keyboard
    IDH_HTML_APPS_USB_hid_keyboard_build               = $0000001D; // APPS USB hid_keyboard_build
    IDH_HTML_APPS_USB_hid_keyboard_configure           = $0000001E; // APPS USB hid_keyboard_configure
    IDH_HTML_APPS_USB_hid_keyboard_run                 = $0000001F; // APPS USB hid_keyboard_run
    IDH_HTML_APPS_USB_hid_mouse                        = $00000020; // APPS USB hid_mouse
    IDH_HTML_APPS_USB_hid_mouse_build                  = $00000021; // APPS USB hid_mouse_build
    IDH_HTML_APPS_USB_hid_mouse_configure              = $00000022; // APPS USB hid_mouse_configure
    IDH_HTML_APPS_USB_hid_mouse_run                    = $00000023; // APPS USB hid_mouse_run
    IDH_HTML_APPS_USB_Device_hid_msd_basic             = $00000024; // APPS USB Device hid_msd_basic
    IDH_HTML_APPS_USB_Device_hid_msd_basic_build       = $00000025; // APPS USB Device hid_msd_basic_build
    IDH_HTML_APPS_USB_Device_hid_msd_basic_configure   = $00000026; // APPS USB Device hid_msd_basic_configure
    IDH_HTML_APPS_USB_Device_hid_msd_basic_run         = $00000027; // APPS USB Device hid_msd_basic_run
    IDH_HTML_APPS_USB_msd_basic                        = $00000028; // APPS USB msd_basic
    IDH_HTML_APPS_USB_msd_basic_build                  = $00000029; // APPS USB msd_basic_build
    IDH_HTML_APPS_USB_msd_basic_configure              = $0000002A; // APPS USB msd_basic_configure
    IDH_HTML_APPS_USB_msd_basic_run                    = $0000002B; // APPS USB msd_basic_run
    IDH_HTML_APPS_USB_generic_device                   = $0000002C; // APPS USB generic_device
    IDH_HTML_APPS_USB_generic_device_build             = $0000002D; // APPS USB generic_device_build
    IDH_HTML_APPS_USB_generic_device_configure         = $0000002E; // APPS USB generic_device_configure
    IDH_HTML_APPS_USB_generic_device_run               = $0000002F; // APPS USB generic_device_run
    IDH_HTML_APPS_USB_Host                             = $00000030; // APPS USB Host
    IDH_HTML_APPS_USB_cdc_basic                        = $00000031; // APPS USB cdc_basic
    IDH_HTML_APPS_USB_cdc_basic_build                  = $00000032; // APPS USB cdc_basic_build
    IDH_HTML_APPS_USB_cdc_basic_configure              = $00000033; // APPS USB cdc_basic_configure
    IDH_HTML_APPS_USB_cdc_basic_run                    = $00000034; // APPS USB cdc_basic_run
    IDH_HTML_APPS_USB_cdc_msd                          = $00000035; // APPS USB cdc_msd
    IDH_HTML_APPS_USB_cdc_msd_build                    = $00000036; // APPS USB cdc_msd_build
    IDH_HTML_APPS_USB_cdc_msd_configure                = $00000037; // APPS USB cdc_msd_configure
    IDH_HTML_APPS_USB_cdc_msd_run                      = $00000038; // APPS USB cdc_msd_run
    IDH_HTML_APPS_USB_HOST_hid_basic_keyboard          = $00000039; // APPS USB HOST hid_basic_keyboard
    IDH_HTML_APPS_USB_HOST_hid_basic_keyboard_build    = $0000003A; // APPS USB HOST hid_basic_keyboard_build
    IDH_HTML_APPS_USB_HOST_hid_basic_keyboard_config   = $0000003B; // APPS USB HOST hid_basic_keyboard_config
    IDH_HTML_APPS_USB_HOST_hid_basic_keyboard_run      = $0000003C; // APPS USB HOST hid_basic_keyboard_run
    IDH_HTML_APPS_USB_msd_basic_host                   = $0000003D; // APPS USB msd_basic_host
    IDH_HTML_APPS_USB_msd_basic_host_build             = $0000003E; // APPS USB msd_basic_host_build
    IDH_HTML_APPS_USB_msd_basic_host_configure         = $0000003F; // APPS USB msd_basic_host_configure
    IDH_HTML_APPS_USB_msd_basic_host_run               = $00000040; // APPS USB msd_basic_host_run
    IDH_HTML_APPS_USB_Host_hid_basic_mouse_usart       = $00000041; // APPS USB Host hid_basic_mouse_usart
    IDH_HTML_APPS_USB_Host_hid_basic_mouse_usart_build = $00000042; // APPS USB Host hid_basic_mouse_usart_build
    IDH_HTML_APPS_USB_Host_hid_basic_mouse_usart_configure = $00000043; // APPS USB Host hid_basic_mouse_usart_configure
    IDH_HTML_APPS_USB_Host_hid_basic_mouse_usart_run   = $00000044; // APPS USB Host hid_basic_mouse_usart_run
    IDH_HTML_USB_Libraries_Help                        = $00000045; // USB Libraries Help
    IDH_HTML_USB_Device_Libraries                      = $00000046; // USB Device Libraries
    IDH_HTML_USB_Device_Library___Getting_Started      = $00000047; // USB Device Library - Getting Started
    IDH_HTML_USB_MID_Introduction                      = $00000048; // USB MID Introduction
    IDH_HTML_USB_MID_USB_Device_Library_Architecture   = $00000049; // USB MID USB Device Library Architecture
    IDH_HTML_USB_MID_USB_Device_Library___Application_Interaction = $0000004A; // USB MID USB Device Library - Application Interaction
    IDH_HTML_USB_MID_Creating_Your_Own_USB_Device      = $0000004B; // USB MID Creating Your Own USB Device
    IDH_HTML_USB_Device_Layer_Library                  = $0000004C; // USB Device Layer Library
    IDH_HTML_USB_DEVLAYER_Introduction                 = $0000004D; // USB DEVLAYER Introduction
    IDH_HTML_USB_DEVLAYER_Using_the_Library            = $0000004E; // USB DEVLAYER Using the Library
    IDH_HTML_USB_DEVLAYER_Abstraction_Model            = $0000004F; // USB DEVLAYER Abstraction Model
    IDH_HTML_USB_DEVLAYER_Library_Overview             = $00000050; // USB DEVLAYER Library Overview
    IDH_HTML_USB_DEVLAYER_How_the_Library_Works        = $00000051; // USB DEVLAYER How the Library Works
    IDH_HTML_USB_DEVLAYER_Initializing_the_library     = $00000052; // USB DEVLAYER Initializing the library
    IDH_HTML_USB_DEVLAYER_Master_Descriptor_Table      = $00000053; // USB DEVLAYER Master Descriptor Table
    IDH_HTML_USB_DEVLAYER_Function_Driver_Registration_Table = $00000054; // USB DEVLAYER Function Driver Registration Table
    IDH_HTML_USB_DEVLAYER_Initializing_the_Device_Layer = $00000055; // USB DEVLAYER Initializing the Device Layer
    IDH_HTML_USB_DEVLAYER_Device_Layer_Task_Routines   = $00000056; // USB DEVLAYER Device Layer Task Routines
    IDH_HTML_USB_DEVLAYER_Application_Client_Interaction = $00000057; // USB DEVLAYER Application Client Interaction
    IDH_HTML_USB_DEVLAYER_Event_Handling               = $00000058; // USB DEVLAYER Event Handling
    IDH_HTML_USB_DEVLAYER_Device_Layer_Control_Transfer = $00000059; // USB DEVLAYER Device Layer Control Transfer
    IDH_HTML_USB_DEVLAYER_String_Descriptor_Table      = $0000005A; // USB DEVLAYER String Descriptor Table
    IDH_HTML_USB_DEVLAYER_BOS_Descriptor_Support       = $0000005B; // USB DEVLAYER BOS Descriptor Support
    IDH_HTML_USB_DEVLAYER_Library_Configuration        = $0000005C; // USB DEVLAYER Library Configuration
    IDH_HTML_USB_DEVLAYER_Building_the_Library         = $0000005D; // USB DEVLAYER Building the Library
    IDH_HTML_USB_DEVLAYER_Library_Interface            = $0000005E; // USB DEVLAYER Library Interface
    IDH_HTML_USB_DEVLAYER_Files                        = $0000005F; // USB DEVLAYER Files
    IDH_HTML_usb_device_h                              = $00000060; // usb_device.h
    IDH_HTML_usb_device_config_template_h              = $00000061; // usb_device_config_template.h
    IDH_HTML_USB_Audio_1_0_Device_Library              = $00000062; // USB Audio 1.0 Device Library
    IDH_HTML_USB_AUDDEV_V1_0_Introduction              = $00000063; // USB AUDDEV V1_0 Introduction
    IDH_HTML_USB_AUDDEV_V1_0_Using_the_Library         = $00000064; // USB AUDDEV V1_0 Using the Library
    IDH_HTML_USB_AUDDEV_V1_0_Abstraction_Model         = $00000065; // USB AUDDEV V1_0 Abstraction Model
    IDH_HTML_USB_AUDDEV_V1_0_Library_Architecture      = $00000066; // USB AUDDEV V1_0 Library Architecture
    IDH_HTML_USB_AUDDEV_V1_0_How_the_Library_Works     = $00000067; // USB AUDDEV V1_0 How the Library Works
    IDH_HTML_USB_AUDDEV_V1_0__Initializing_the_Library = $00000068; // USB AUDDEV V1_0  Initializing the Library
    IDH_HTML_USB_AUDDEV_V1_0_Event_Handling            = $00000069; // USB AUDDEV V1_0 Event Handling
    IDH_HTML_USB_AUDDEV_V1_0_Transferring_Data         = $0000006A; // USB AUDDEV V1_0 Transferring Data
    IDH_HTML_USB_AUDDEV_V1_0_Configuring_the_Library   = $0000006B; // USB AUDDEV V1_0 Configuring the Library
    IDH_HTML_USB_AUDDEV_V1_0_Building_the_Library      = $0000006C; // USB AUDDEV V1_0 Building the Library
    IDH_HTML_USB_AUDDEV_V1_0_Library_Interface         = $0000006D; // USB AUDDEV V1_0 Library Interface
    IDH_HTML_USB_AUDDEV_V1_0_Files                     = $0000006E; // USB AUDDEV V1_0 Files
    IDH_HTML_usb_device_audio_v1_0_h                   = $0000006F; // usb_device_audio_v1_0.h
    IDH_HTML_usb_device_audio_v1_0_config_template_h   = $00000070; // usb_device_audio_v1_0_config_template.h
    IDH_HTML_USB_Audio_2_0_Device_Library              = $00000071; // USB Audio 2.0 Device Library
    IDH_HTML_USB_AUDDEV_V2_0_Introduction              = $00000072; // USB AUDDEV V2_0 Introduction
    IDH_HTML_USB_AUDDEV_V2_0_Using_the_Library         = $00000073; // USB AUDDEV V2_0 Using the Library
    IDH_HTML_USB_AUDDEV_V2_0_Abstraction_Model         = $00000074; // USB AUDDEV V2_0 Abstraction Model
    IDH_HTML_USB_AUDDEV_V2_0_Library_Architecture      = $00000075; // USB AUDDEV V2_0 Library Architecture
    IDH_HTML_USB_AUDDEV_V2_0_How_the_Library_Works     = $00000076; // USB AUDDEV V2_0 How the Library Works
    IDH_HTML_USB_AUDDEV_V2_0_Initializing_the_Library  = $00000077; // USB AUDDEV V2_0 Initializing the Library
    IDH_HTML_USB_AUDDEV_V2_0_Event_Handling            = $00000078; // USB AUDDEV V2_0 Event Handling
    IDH_HTML_USB_AUDDEV_V2_0_Transferring_Data         = $00000079; // USB AUDDEV V2_0 Transferring Data
    IDH_HTML_USB_AUDDEV_V2_0_Configuring_the_Library   = $0000007A; // USB AUDDEV V2_0 Configuring the Library
    IDH_HTML_USB_AUDDEV_V2_0_Building_the_Library      = $0000007B; // USB AUDDEV V2_0 Building the Library
    IDH_HTML_USB_AUDDEV_V2_0_Library_Interface         = $0000007C; // USB AUDDEV V2_0 Library Interface
    IDH_HTML_USB_AUDDEV_V2_0_Files                     = $0000007D; // USB AUDDEV V2_0 Files
    IDH_HTML_usb_device_audio_v2_0_h                   = $0000007E; // usb_device_audio_v2_0.h
    IDH_HTML_usb_device_audio_v2_0_config_template_h   = $0000007F; // usb_device_audio_v2_0_config_template.h
    IDH_HTML_USB_Device_CDC_Library                    = $00000080; // USB Device CDC Library
    IDH_HTML_USB_DEVCDC_Introduction                   = $00000081; // USB DEVCDC Introduction
    IDH_HTML_USB_DEVCDC_Using_the_Library              = $00000082; // USB DEVCDC Using the Library
    IDH_HTML_USB_DEVCDC_Abstraction_Model              = $00000083; // USB DEVCDC Abstraction Model
    IDH_HTML_USB_DEVCDC_Abstract_Control_Model__ACM_   = $00000084; // USB DEVCDC Abstract Control Model (ACM)
    IDH_HTML_USB_DEVCDC_Library_Architecture           = $00000085; // USB DEVCDC Library Architecture
    IDH_HTML_USB_DEVCDC_How_the_Library_Works          = $00000086; // USB DEVCDC How the Library Works
    IDH_HTML_USB_DEVCDC_Library_Initialization         = $00000087; // USB DEVCDC Library Initialization
    IDH_HTML_USB_DEVCDC_Event_Handling                 = $00000088; // USB DEVCDC Event Handling
    IDH_HTML_USB_DEVCDC_Sending_Data                   = $00000089; // USB DEVCDC Sending Data
    IDH_HTML_USB_DEVCDC_Receiving_Data                 = $0000008A; // USB DEVCDC Receiving Data
    IDH_HTML_USB_DEVCDC_Configuring_the_Library        = $0000008B; // USB DEVCDC Configuring the Library
    IDH_HTML_USB_DEVCDC_Building_the_Library           = $0000008C; // USB DEVCDC Building the Library
    IDH_HTML_USB_DEVCDC_Library_Interface              = $0000008D; // USB DEVCDC Library Interface
    IDH_HTML_USB_DEVCDC_Files                          = $0000008E; // USB DEVCDC Files
    IDH_HTML_usb_device_cdc_h                          = $0000008F; // usb_device_cdc.h
    IDH_HTML_usb_cdc_h                                 = $00000090; // usb_cdc.h
    IDH_HTML_usb_device_cdc_config_template_h          = $00000091; // usb_device_cdc_config_template.h
    IDH_HTML_USB_HID_Device_Library                    = $00000092; // USB HID Device Library
    IDH_HTML_USB_HIDDEV_Introduction                   = $00000093; // USB HIDDEV Introduction
    IDH_HTML_USB_HIDDEV_Using_the_Library              = $00000094; // USB HIDDEV Using the Library
    IDH_HTML_USB_HIDDEV_Architecture_Overview          = $00000095; // USB HIDDEV Architecture Overview
    IDH_HTML_USB_HIDDEV_Library_Architecture           = $00000096; // USB HIDDEV Library Architecture
    IDH_HTML_USB_HIDDEV_How_the_Library_Works          = $00000097; // USB HIDDEV How the Library Works
    IDH_HTML_USB_HIDDEV_Library_Initialization         = $00000098; // USB HIDDEV Library Initialization
    IDH_HTML_USB_HIDDEV_Event_Handling                 = $00000099; // USB HIDDEV Event Handling
    IDH_HTML_USB_HIDDEV_Sending_a_Report               = $0000009A; // USB HIDDEV Sending a Report
    IDH_HTML_USB_HIDDEV_Receiving_a_Report             = $0000009B; // USB HIDDEV Receiving a Report
    IDH_HTML_USB_HIDDEV_Configuring_the_Library        = $0000009C; // USB HIDDEV Configuring the Library
    IDH_HTML_USB_HIDDEV_Building_the_Library           = $0000009D; // USB HIDDEV Building the Library
    IDH_HTML_USB_HIDDEV_Library_Interface              = $0000009E; // USB HIDDEV Library Interface
    IDH_HTML_USB_HIDDEV_Files                          = $0000009F; // USB HIDDEV Files
    IDH_HTML_usb_device_hid_h                          = $000000A0; // usb_device_hid.h
    IDH_HTML_usb_device_hid_config_template_h          = $000000A1; // usb_device_hid_config_template.h
    IDH_HTML_USB_Vendor_Device_Library                 = $000000A2; // USB Vendor Device Library
    IDH_HTML_USB_VENDORDEV_Introduction                = $000000A3; // USB VENDORDEV Introduction
    IDH_HTML_USB_VENDORDEV_Using_the_Library           = $000000A4; // USB VENDORDEV Using the Library
    IDH_HTML_USB_VENDORDEV_Library_Overview            = $000000A5; // USB VENDORDEV Library Overview
    IDH_HTML_USB_VENDORDEV_Abstraction_Model           = $000000A6; // USB VENDORDEV Abstraction Model
    IDH_HTML_USB_VENDORDEV_How_the_Library_Works       = $000000A7; // USB VENDORDEV How the Library Works
    IDH_HTML_USB_VENDORDEV_Library_Initialization      = $000000A8; // USB VENDORDEV Library Initialization
    IDH_HTML_USB_VENDORDEV_Event_Handling              = $000000A9; // USB VENDORDEV Event Handling
    IDH_HTML_USB_VENDORDEV_Control_Transfer_Events     = $000000AA; // USB VENDORDEV Control Transfer Events
    IDH_HTML_USB_VENDORDEV_Endpoint_Data_Transfer_Events = $000000AB; // USB VENDORDEV Endpoint Data Transfer Events
    IDH_HTML_USB_VENDORDEV_Endpoint_Management         = $000000AC; // USB VENDORDEV Endpoint Management
    IDH_HTML_USB_VENDORDEV_Endpoint_Data_Transfer      = $000000AD; // USB VENDORDEV Endpoint Data Transfer
    IDH_HTML_USB_VENDORDEV_Configuring_the_Library     = $000000AE; // USB VENDORDEV Configuring the Library
    IDH_HTML_USB_VENDORDEV_Building_the_Library        = $000000AF; // USB VENDORDEV Building the Library
    IDH_HTML_USB_VENDORDEV_Library_Interface           = $000000B0; // USB VENDORDEV Library Interface
    IDH_HTML_USB_MSD_Device_Library                    = $000000B1; // USB MSD Device Library
    IDH_HTML_USB_MSDDEV_Introduction                   = $000000B2; // USB MSDDEV Introduction
    IDH_HTML_USB_MSDDEV_Using_the_Library              = $000000B3; // USB MSDDEV Using the Library
    IDH_HTML_USB_MSDDEV_Abstraction_Model              = $000000B4; // USB MSDDEV Abstraction Model
    IDH_HTML_USB_MSDDEV_Library_Overview               = $000000B5; // USB MSDDEV Library Overview
    IDH_HTML_USB_MSDDEV_How_the_Library_Works          = $000000B6; // USB MSDDEV How the Library Works
    IDH_HTML_USB_MSDDEV_Library_Initialization         = $000000B7; // USB MSDDEV Library Initialization
    IDH_HTML_USB_MSDDEV_Data_Transfer                  = $000000B8; // USB MSDDEV Data Transfer
    IDH_HTML_USB_MSD_Configuring_the_Library           = $000000B9; // USB MSD Configuring the Library
    IDH_HTML_USB_MSDDEV_Building_the_Library           = $000000BA; // USB MSDDEV Building the Library
    IDH_HTML_USB_MSDDEV_Library_Interface              = $000000BB; // USB MSDDEV Library Interface
    IDH_HTML_USB_MSDDEV_Files                          = $000000BC; // USB MSDDEV Files
    IDH_HTML_usb_device_msd_h                          = $000000BD; // usb_device_msd.h
    IDH_HTML_usb_device_msd_config_template_h          = $000000BE; // usb_device_msd_config_template.h
    IDH_HTML_USB_Host_Libraries                        = $000000BF; // USB Host Libraries
    IDH_HTML_USB_Host_Library___Getting_Started        = $000000C0; // USB Host Library - Getting Started
    IDH_HTML_USB_HOST_GS_Introduction                  = $000000C1; // USB HOST GS Introduction
    IDH_HTML_USB_HOST_GS_USB_Host_Library_Architecture = $000000C2; // USB HOST GS USB Host Library Architecture
    IDH_HTML_USB_HOST_GS_USB_Host_Library___Application_Interaction = $000000C3; // USB HOST GS USB Host Library - Application Interaction
    IDH_HTML_USB_Host_Layer_Library                    = $000000C4; // USB Host Layer Library
    IDH_HTML_USB_HOST_Introduction                     = $000000C5; // USB HOST Introduction
    IDH_HTML_USB_HOST_Using_the_Library                = $000000C6; // USB HOST Using the Library
    IDH_HTML_USB_HOST_Abstraction_Model                = $000000C7; // USB HOST Abstraction Model
    IDH_HTML_USB_HOST_Library_Overview                 = $000000C8; // USB HOST Library Overview
    IDH_HTML_USB_HOST_How_the_Library_Works            = $000000C9; // USB HOST How the Library Works
    IDH_HTML_USB_HOST_Host_Layer_Initialization        = $000000CA; // USB HOST Host Layer Initialization
    IDH_HTML_USB_HOST_Host_Layer___Application_Interaction = $000000CB; // USB HOST Host Layer - Application Interaction
    IDH_HTML_USB_HOST_Event_Handling                   = $000000CC; // USB HOST Event Handling
    IDH_HTML_USB_HOST_Configuring_the_Library          = $000000CD; // USB HOST Configuring the Library
    IDH_HTML_USB_HOST_Building_the_Library             = $000000CE; // USB HOST Building the Library
    IDH_HTML_USB_HOST_Library_Interface                = $000000CF; // USB HOST Library Interface
    IDH_HTML_USB_HOST_Files                            = $000000D0; // USB HOST Files
    IDH_HTML_usb_host_h                                = $000000D1; // usb_host.h
    IDH_HTML_usb_host_config_template_h                = $000000D2; // usb_host_config_template.h
    IDH_HTML_USB_Audio_v1_0_Host_Client_Driver_Library = $000000D3; // USB Audio v1.0 Host Client Driver Library
    IDH_HTML_USB_AUDIO1_0_HOST_Introduction            = $000000D4; // USB AUDIO1_0 HOST Introduction
    IDH_HTML_USB_AUDIO1_0_HOST_Using_the_Library       = $000000D5; // USB AUDIO1_0 HOST Using the Library
    IDH_HTML_USB_AUDIO1_0_HOST_Abstraction_Model       = $000000D6; // USB AUDIO1_0 HOST Abstraction Model
    IDH_HTML_USB_AUDIO1_0_HOST_Library_Architecture    = $000000D7; // USB AUDIO1_0 HOST Library Architecture
    IDH_HTML_USB_AUDIO1_0_HOST_How_the_Library_Works   = $000000D8; // USB AUDIO1_0 HOST How the Library Works
    IDH_HTML_USB_AUDIO1_0_HOST_TPL_Table_Configuration_for_Audio_v1_0_Devices = $000000D9; // USB AUDIO1_0 HOST TPL Table Configuration for Audio v1.0 Devices
    IDH_HTML_USB_AUDIO1_0_HOST_Detecting_Device_Attach = $000000DA; // USB AUDIO1_0 HOST Detecting Device Attach
    IDH_HTML_USB_AUDIO1_0_HOST_Obtaining_Audio_v1_0_Device_Audio_Stream_Details = $000000DB; // USB AUDIO1_0 HOST Obtaining Audio v1.0 Device Audio Stream Details
    IDH_HTML_USB_AUDIO1_0_HOST_Obtaining_an_Audio_Stream = $000000DC; // USB AUDIO1_0 HOST Obtaining an Audio Stream
    IDH_HTML_USB_AUDIO1_0_HOST_Audio_Stream_Event_Handling = $000000DD; // USB AUDIO1_0 HOST Audio Stream Event Handling
    IDH_HTML_USB_AUDIO1_0_HOST_Enabling_Audio_Stream   = $000000DE; // USB AUDIO1_0 HOST Enabling Audio Stream
    IDH_HTML_USB_AUDIO1_0_HOST_Setting_the_Desired_Audio_Stream_Sampling_Rate = $000000DF; // USB AUDIO1_0 HOST Setting the Desired Audio Stream Sampling Rate
    IDH_HTML_USB_AUDIO1_0_HOST_Audio_Data_Streaming    = $000000E0; // USB AUDIO1_0 HOST Audio Data Streaming
    IDH_HTML_USB_AUDIO1_0_HOST_Sending_Class_Specific_Control_Transfers = $000000E1; // USB AUDIO1_0 HOST Sending Class Specific Control Transfers
    IDH_HTML_USB_AUDIO1_0_HOST_Configuring_the_Library = $000000E2; // USB AUDIO1_0 HOST Configuring the Library
    IDH_HTML_USB_AUDIO1_0_HOST_Building_the_Library    = $000000E3; // USB AUDIO1_0 HOST Building the Library
    IDH_HTML_USB_AUDIO1_0_HOST_Library_Interface       = $000000E4; // USB AUDIO1_0 HOST Library Interface
    IDH_HTML_USB_AUDIO1_0_HOST_Files                   = $000000E5; // USB AUDIO1_0 HOST Files
    IDH_HTML_usb_host_audio_v1_0_h                     = $000000E6; // usb_host_audio_v1_0.h
    IDH_HTML_usb_host_cdc_h                            = $000000E7; // usb_host_cdc.h
    IDH_HTML_usb_host_hub_config_template_h            = $000000E8; // usb_host_hub_config_template.h
    IDH_HTML_usb_host_audio_v1_0_config_template_h     = $000000E9; // usb_host_audio_v1_0_config_template.h
    IDH_HTML_USB_CDC_Host_Library                      = $000000EA; // USB CDC Host Library
    IDH_HTML_USB_CDC_HOST_Introduction                 = $000000EB; // USB CDC HOST Introduction
    IDH_HTML_USB_CDC_HOST_Using_the_Library            = $000000EC; // USB CDC HOST Using the Library
    IDH_HTML_USB_CDC_HOST_Abstraction_Model            = $000000ED; // USB CDC HOST Abstraction Model
    IDH_HTML_USB_CDC_HOST_Library_Overview             = $000000EE; // USB CDC HOST Library Overview
    IDH_HTML_USB_CDC_HOST_How_the_Library_Works        = $000000EF; // USB CDC HOST How the Library Works
    IDH_HTML_USB_CDC_HOST_TPL_Table_Configuration_for_CDC_Devices = $000000F0; // USB CDC HOST TPL Table Configuration for CDC Devices
    IDH_HTML_USB_CDC_HOST_Detecting_Device_Attach      = $000000F1; // USB CDC HOST Detecting Device Attach
    IDH_HTML_USB_CDC_HOST_Opening_the_CDC_Host_Client_Driver = $000000F2; // USB CDC HOST Opening the CDC Host Client Driver
    IDH_HTML_USB_CDC_HOST_Sending_Class_specific_Control_Transfers = $000000F3; // USB CDC HOST Sending Class-specific Control Transfers
    IDH_HTML_USB_CDC_HOST_Reading_and_Writing_Data     = $000000F4; // USB CDC HOST Reading and Writing Data
    IDH_HTML_USB_CDC_HOST_Event_Handling               = $000000F5; // USB CDC HOST Event Handling
    IDH_HTML_USB_CDC_HOST_Configuring_the_Library      = $000000F6; // USB CDC HOST Configuring the Library
    IDH_HTML_USB_CDC_HOST_Building_the_Library         = $000000F7; // USB CDC HOST Building the Library
    IDH_HTML_USB_CDC_HOST_Library_Interface            = $000000F8; // USB CDC HOST Library Interface
    IDH_HTML_USB_CDC_HOST_Files                        = $000000F9; // USB CDC HOST Files
    IDH_HTML_usb_host_cdc_config_template_h            = $000000FA; // usb_host_cdc_config_template.h
    IDH_HTML_USB_HID_Host_Mouse_Driver_Library         = $000000FB; // USB HID Host Mouse Driver Library
    IDH_HTML_USB_HID_HOST_MOUSE_Introduction           = $000000FC; // USB HID HOST MOUSE Introduction
    IDH_HTML_USB_HID_HOST_MOUSE_Using_the_Library      = $000000FD; // USB HID HOST MOUSE Using the Library
    IDH_HTML_USB_HID_HOST_MOUSE_Abstraction_Model      = $000000FE; // USB HID HOST MOUSE Abstraction Model
    IDH_HTML_USB_HID_HOST_MOUSE_Library_Architecture   = $000000FF; // USB HID HOST MOUSE Library Architecture
    IDH_HTML_USB_HID_HOST_MOUSE_How_the_Library_Works  = $00000100; // USB HID HOST MOUSE How the Library Works
    IDH_HTML_USB_HID_HOST_MOUSE_HID_Device_TPL_Table_Configuration = $00000101; // USB HID HOST MOUSE HID Device TPL Table Configuration
    IDH_HTML_USB_HID_HOST_MOUSE_Detecting_Device_Attach = $00000102; // USB HID HOST MOUSE Detecting Device Attach
    IDH_HTML_USB_HID_HOST_MOUSE_Mouse_Data_Event_Handling = $00000103; // USB HID HOST MOUSE Mouse Data Event Handling
    IDH_HTML_USB_HID_HOST_MOUSE_Configuring_the_Library = $00000104; // USB HID HOST MOUSE Configuring the Library
    IDH_HTML_USB_HID_HOST_MOUSE_Building_the_Library   = $00000105; // USB HID HOST MOUSE Building the Library
    IDH_HTML_USB_HID_HOST_MOUSE_Library_Interface      = $00000106; // USB HID HOST MOUSE Library Interface
    IDH_HTML_USB_HID_HOST_MOUSE_Files                  = $00000107; // USB HID HOST MOUSE Files
    IDH_HTML_usb_host_hid_mouse_h                      = $00000108; // usb_host_hid_mouse.h
    IDH_HTML_usb_host_hid_config_template_h            = $00000109; // usb_host_hid_config_template.h
    IDH_HTML_USB_Hub_Host_Client_Driver_Library        = $0000010A; // USB Hub Host Client Driver Library
    IDH_HTML_USB_HUB_HOST_Introduction                 = $0000010B; // USB HUB HOST Introduction
    IDH_HTML_USB_HUB_HOST_Using_the_Library            = $0000010C; // USB HUB HOST Using the Library
    IDH_HTML_USB_HUB_HOST_Abstraction_Model            = $0000010D; // USB HUB HOST Abstraction Model
    IDH_HTML_USB_HUB_HOST_Library_Architecture         = $0000010E; // USB HUB HOST Library Architecture
    IDH_HTML_USB_HUB_HOST_How_the_Library_Works        = $0000010F; // USB HUB HOST How the Library Works
    IDH_HTML_USB_HUB_HOST_Hub_TPL_Table_Configuration  = $00000110; // USB HUB HOST Hub TPL Table Configuration
    IDH_HTML_USB_HUB_HOST_USB_Host_Hub_Driver_Test_Results = $00000111; // USB HUB HOST USB Host Hub Driver Test Results
    IDH_HTML_USB_HUB_HOST_Configuring_the_Library      = $00000112; // USB HUB HOST Configuring the Library
    IDH_HTML_USB_HUB_HOST_Building_the_Library         = $00000113; // USB HUB HOST Building the Library
    IDH_HTML_USB_HUB_HOST_Library_Interface            = $00000114; // USB HUB HOST Library Interface
    IDH_HTML_USB_HUB_HOST_Files                        = $00000115; // USB HUB HOST Files
    IDH_HTML_usb_host_hub_h                            = $00000116; // usb_host_hub.h
    IDH_HTML_USB_MSD_Host_Library                      = $00000117; // USB MSD Host Library
    IDH_HTML_USB_MSD_HOST_Introduction                 = $00000118; // USB MSD HOST Introduction
    IDH_HTML_USB_MSD_HOST_Using_the_Library            = $00000119; // USB MSD HOST Using the Library
    IDH_HTML_USB_MSD_HOST_Abstraction_Model            = $0000011A; // USB MSD HOST Abstraction Model
    IDH_HTML_USB_MSD_HOST_Library_Architecture         = $0000011B; // USB MSD HOST Library Architecture
    IDH_HTML_USB_MSD_HOST_How_the_Library_Works        = $0000011C; // USB MSD HOST How the Library Works
    IDH_HTML_USB_MSD_HOST_MSD_TPL_Table_Configuration  = $0000011D; // USB MSD HOST MSD TPL Table Configuration
    IDH_HTML_USB_MSD_HOST_Data_Transfer                = $0000011E; // USB MSD HOST Data Transfer
    IDH_HTML_USB_MSD_HOST_Configuring_the_Library      = $0000011F; // USB MSD HOST Configuring the Library
    IDH_HTML_USB_MSD_HOST_Building_the_Library         = $00000120; // USB MSD HOST Building the Library
    IDH_HTML_USB_MSD_HOST_Library_Interface            = $00000121; // USB MSD HOST Library Interface
    IDH_HTML_USB_MSD_HOST_Files                        = $00000122; // USB MSD HOST Files
    IDH_HTML_usb_host_msd_h                            = $00000123; // usb_host_msd.h
    IDH_HTML_usb_host_msd_config_template_h            = $00000124; // usb_host_msd_config_template.h
    IDH_HTML_usb_drv_common_Library                    = $00000125; // usb_drv_common Library
    IDH_HTML_DRV_USB_COMMON_Common_Interface           = $00000126; // DRV USB COMMON Common Interface
    IDH_HTML_DRV_USB_COMMON_Driver_Host_Mode_Client_Functions = $00000127; // DRV USB COMMON Driver Host Mode Client Functions
    IDH_HTML_DRV_USB_COMMON_Driver_Host_Root_Hub_Interface = $00000128; // DRV USB COMMON Driver Host Root Hub Interface
    IDH_HTML_DRV_USB_COMMON_Driver_Host_USB_Root_Hub_Port_Interface = $00000129; // DRV USB COMMON Driver Host USB Root Hub Port Interface
    IDH_HTML_DRV_USB_COMMON_Driver_Device_Mode_Client_Functions = $0000012A; // DRV USB COMMON Driver Device Mode Client Functions
    IDH_HTML_DRV_USB_COMMON_Driver_General_Client_Functions = $0000012B; // DRV USB COMMON Driver General Client Functions
    IDH_HTML_DRV_USB_COMMON_Opening_the_Driver         = $0000012C; // DRV USB COMMON Opening the Driver
    IDH_HTML_DRV_USB_COMMON_USB_Driver_Host_Mode_Operation = $0000012D; // DRV USB COMMON USB Driver Host Mode Operation
    IDH_HTML_DRV_USB_COMMON_USB_Driver_Device_Mode_Operation = $0000012E; // DRV USB COMMON USB Driver Device Mode Operation
    IDH_HTML_DRV_USB_COMMON_General_Device_Mode_Operations = $0000012F; // DRV USB COMMON General Device Mode Operations
    IDH_HTML_DRV_USB_COMMON_Device_Endpoint_Operations = $00000130; // DRV USB COMMON Device Endpoint Operations
    IDH_HTML_DRV_USB_COMMON_Transferring_Data_to_the_Host = $00000131; // DRV USB COMMON Transferring Data to the Host
    IDH_HTML_USB_DEV_DRV_WIN8_Driver_Signing_and_Windows_8 = $00000132; // USB DEV DRV WIN8 Driver Signing and Windows 8
    IDH_HTML_USB_DRV_DEV_WIN_8_What_are__Signed__Drivers = $00000133; // USB DRV DEV WIN 8 What are "Signed" Drivers
    IDH_HTML_USB_DEV_DRV_WIN8_Minimum_Driver_Signature_Requirements = $00000134; // USB DEV DRV WIN8 Minimum Driver Signature Requirements
    IDH_HTML_USB_DEV_DRV_WIN8_Using_Older_Drivers_With_Windows_8 = $00000135; // USB DEV DRV WIN8 Using Older Drivers With Windows 8
    IDH_HTML_USB_DEV_DRV_WIN8_USB_Application_Project_Driver_Signatures = $00000136; // USB DEV DRV WIN8 USB Application Project Driver Signatures
    IDH_HTML_USB_DEV_DRV_WIN8_Obtaining_a_Microsoft_Authenticode_Code_Signing_Certificate = $00000137; // USB DEV DRV WIN8 Obtaining a Microsoft Authenticode Code Signing Certificate
    IDH_HTML_USB_DEV_DRV_WIN8_Code_Signing_Certificates__Other_Uses_ = $00000138; // USB DEV DRV WIN8 Code Signing Certificates (Other Uses)
    IDH_HTML_USB_DEV_DRV_WIN8_Using_a_Code_Signing_Certificate_to_Sign_Driver_Packages = $00000139; // USB DEV DRV WIN8 Using a Code Signing Certificate to Sign Driver Packages
    IDH_HTML_HARMONY_Support                           = $0000013A; // HARMONY Support
    IDH_HTML_HARMONY_About_This_Help_File              = $0000013B; // HARMONY About This Help File
    IDH_HTML_HARMONY_Trademarks                        = $0000013C; // HARMONY Trademarks
    IDH_HTML_HARMONY_Conventions_Used                  = $0000013D; // HARMONY Conventions Used
    IDH_HTML_HARMONY_Recommended_Reading               = $0000013E; // HARMONY Recommended Reading
    IDH_HTML_HARMONY_Documentation_Feedback            = $0000013F; // HARMONY Documentation Feedback
    IDH_HTML_HARMONY_Help_Features                     = $00000140; // HARMONY Help Features
    IDH_HTML_HARMONY_Compiled_Help_Features            = $00000141; // HARMONY Compiled Help Features
    IDH_HTML_HARMONY_HTML_Help_Features                = $00000142; // HARMONY HTML Help Features
    IDH_HTML_HARMONY_PDF_Help_Features                 = $00000143; // HARMONY PDF Help Features
    IDH_HTML_HARMONY_The_Microchip_Web_Site            = $00000144; // HARMONY The Microchip Web Site
    IDH_HTML_HARMONY_Microchip_Forums                  = $00000145; // HARMONY Microchip Forums
    IDH_HTML_HARMONY_Customer_Support                  = $00000146; // HARMONY Customer Support
    IDH_HTML_HARMONY_Contact_Microchip_Technology      = $00000147; // HARMONY Contact Microchip Technology
    IDH_HTML_HARMONY_Glossary                          = $00000148; // HARMONY Glossary
    IDH_HTML_Topic1                                    = $00000149; // Topic1
    IDH_HTML___FILES                                   = $0000014A; // !!FILES
    IDH_HTML_drv_usbfs_config_template_h               = $0000014B; // drv_usbfs_config_template.h
